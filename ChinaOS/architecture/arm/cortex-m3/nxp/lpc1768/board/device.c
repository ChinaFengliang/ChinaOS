/******************************************************Copyright (c)**************************************************
**                                              胆怯是阻止一切可能的根本缘由
**
**                                             E-Mail: ChinaFengliang@163.com
**
**---------File Information-------------------------------------------------------------------------------------------+
** File name:            device.c
** Last version:         V1.00
** Descriptions:         设备管理文件.
** Hardware platform:    lpc1768
** SoftWare platform:    ChinaOS
**
**--------------------------------------------------------------------------------------------------------------------
** Created by:           FengLiang
** Created date:         2010年8月25日  14:27:47
** Version:              V1.00
** Descriptions:         The original version
**
**--------------------------------------------------------------------------------------------------------------------
** Modified by:
** Modified date:
** Version:
** Descriptions:
**
*********************************************************************************************************************/
#define     DEBUG_LOCAL_EN                          0                       /* 本地调试开关: 0:关; 1:开             */
/*********************************************************************************************************************
                                                   头文件区
*********************************************************************************************************************/
#include    <include/OS_macro.h>
#include    <include/OS_types.h>
#include    <debug/debug.h>
#include    "./device.h"


/*********************************************************************************************************************
                                                   全局变量定义区
*********************************************************************************************************************/



/*********************************************************************************************************************
** Function name:           device_setup
** Descriptions:            安装系统默认设备
** Input parameters:        None
** Output parameters:       
** Returned value:          ==OS_OK : 操作成功
**                          !=OS_OK : 操作失败(包含出错信息)
**--------------------------------------------------------------------------------------------------------------------
** Created by:              Fengliang
** Created Date:            2010-8-24  15:57:4
** Test recorde:
**--------------------------------------------------------------------------------------------------------------------
** Modified by:
** Modified date:
** Test recorde:
*********************************************************************************************************************/
int device_setup(void)
{
    int                 Status;                                             /* 设备安装信息                         */


#if (DEVICE_ALARM_EN == 1)    
    Status = alarm.setup();                                                 /* 安装报警器设备                       */
    if (OS_OK != Status)
    {
        DBG_WARN("安装报警器设备失败: %d\r\n", Status);
    }
#endif


#if (DEVICE_LED_2_EN == 1)  
    Status = led2.setup();                                                  /* 安装指示灯设备                       */
    if (OS_OK != Status)
    {
        DBG_WARN("安装指示灯设备失败: %d\r\n", Status);
    }
#endif

#if (DEVICE_LED_1_EN == 1)  
    Status = led1.setup();                                                  /* 安装指示灯设备                       */
    if (OS_OK != Status)
    {
        DBG_WARN("安装指示灯设备失败: %d\r\n", Status);
    }
#endif  

#if (DEVICE_UART0_EN == 1)  
    Status = uart0.setup(115200);                                           /* 安装uart0设备                       */
    if (OS_OK != Status)
    {
        DBG_WARN("安装uart0设备失败: %d\r\n", Status);
    }
#endif  

#if (DEVICE_UART2_EN == 1)  
    Status = uart2.setup(115200);                                           /* 安装uart2设备                       */
    if (OS_OK != Status)
    {
        DBG_WARN("安装uart2设备失败: %d\r\n", Status);
    }
#endif  

#if (DEVICE_UART3_EN == 1)  
    Status = uart3.setup(115200);                                           /* 安装uart3设备                       */
    if (OS_OK != Status)
    {
        DBG_WARN("安装uart3设备失败: %d\r\n", Status);
    }
#endif  


    return OS_OK;
}

/*********************************************************************************************************************
                                                   END OF FILE
*********************************************************************************************************************/

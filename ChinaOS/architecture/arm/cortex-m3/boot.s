;/******************************************************Copyright (c)**************************************************
;**                                              胆怯是阻止一切可能的根本缘由
;**
;**                                             E-Mail: ChinaFengliang@163.com
;**
;**---------File Information-------------------------------------------------------------------------------------------
;** File name:            boot.s
;** Last version:         V1.00
;** Descriptions:         系统引导文件.
;** Hardware platform:	  lpc1768(内核: Cortex-M3)
;** SoftWare platform:	  ChinaOS 
;**
;**--------------------------------------------------------------------------------------------------------------------
;** Created by:           Fengliang
;** Created date:         2010年9月3日  14:6:17
;** Version:              V1.00
;** Descriptions:         The original version
;**
;**--------------------------------------------------------------------------------------------------------------------
;** Modified by:
;** Modified date:
;** Version:
;** Descriptions:
;**
;*********************************************************************************************************************/

;/*********************************************************************************************************************
;                                                    头文件区
;*********************************************************************************************************************/


;/*********************************************************************************************************************
;                                                    宏定义区
;*********************************************************************************************************************/
;/* 配置堆栈的空间大小 ----------------------------------------------------------------------------------------------*/
SYSTEM_STACK_SIZE  EQU         2048											;/* 系统栈空间size						 */


;/*********************************************************************************************************************
;                                                   接口申明区
;*********************************************************************************************************************/
;/* 导出接口 --------------------------------------------------------------------------------------------------------*/

;/* 导入接口 --------------------------------------------------------------------------------------------------------*/
	IMPORT			startup
	IMPORT			cpu_init
	IMPORT          syscall_exception
	IMPORT          pendsv_exception
	IMPORT  		systimer_exception
	;IMPORT  		usbDevException
	IMPORT          can_exception
	;IMPORT          ethernet_exception

    IMPORT			|Load$$RW$$Base|										;/* 非默认初始化全局变量种子区起始地址	*/
   	IMPORT			|Image$$RW$$Base|										;/* 非默认初始化全局变量目标区起始地址  */
    IMPORT			|Image$$RW$$ZI$$Base|									;/* 默认初始化全局变量目标区起始地址	*/
	IMPORT			|Image$$RW$$ZI$$Limit|									;/* 默认初始化全局变量目标区限制地址	*/

;/*********************************************************************************************************************
;                                                   代码实现区
;*********************************************************************************************************************/
	AREA  boot, CODE, READONLY
	ENTRY																	;/* entry point							 */
;/*********************************************************************************************************************
;** Function name:           exception_entry
;** Descriptions:            中断/异常向量入口
;** Input parameters:
;** Output parameters:
;** Returned value:
;**
;**--------------------------------------------------------------------------------------------------------------------
;** Created by:
;** Created Date:            2010-9-3  14:46:37
;** Test recorde:
;**--------------------------------------------------------------------------------------------------------------------
;** Modified by:
;** Modified date:
;** Test recorde:
;*********************************************************************************************************************/
exception_entry
		DCD 	system_stack_base + SYSTEM_STACK_SIZE - 32					;/* 0) 系统栈底(MSP初始值)   		     */
		DCD     reset_exception												;/* 1) 复位异常							 */
		DCD		.															;/* 2) 超级异常(NMI引脚)				 */
		DCD		hard_faults													;/* 3) 硬异常(fault)					 */
		
		DCD		memory_manage_faults     									;/* 4) 存储器管理异常					 */
		DCD		bus_faults                                                  ;/* 5) 总线异常							 */
		DCD     usage_faults												;/* 6) 用法异常    						 */
		DCD		default_service												;/* 7) (保留)                            */
		
		DCD     default_service												;/* 8) (保留)                            */
		DCD     default_service												;/* 9) (保留)                            */
		DCD     default_service												;/* A) (保留)                            */
		DCD     syscall_exception										    ;/* B) 系统调用中断    			    	 */
		
		DCD     .															;/* C) 调试监视器						 */
		DCD     default_service												;/* D) (保留)                            */
		DCD     pendsv_exception											;/* E) PendSV中断                        */
		DCD     systimer_exception   										;/* F) SysTick中断                       */
				
		DCD     .															;/* 16) 看门狗中断						 */
		DCD     systimer_exception											;/* 17) 定时器0中断						 */
		DCD     .															;/* 18) 定时器1中断						 */
		DCD     .															;/* 19) 定时器2中断						 */

		DCD     .															;/* 20) 定时器3中断						 */
		DCD     .															;/* 21) 串口0中断						 */
		DCD     .															;/* 22) 串口1中断						 */
		DCD     .															;/* 23) 串口2中断						 */

		DCD     .															;/* 24) 串口3中断						 */
		DCD     .															;/* 25) PWM1中断						 */
		DCD     .															;/* 26) I2C0中断						 */
		DCD     .															;/* 27) I2C1中断						 */

		DCD     .															;/* 28) I2C2中断						 */
		DCD     .															;/* 29) SPI中断	     					 */
		DCD     .															;/* 30) SSP0中断						 */
		DCD     .															;/* 31) SSP1中断						 */

		DCD     .															;/* 32) PLL0中断						 */
		DCD     .															;/* 33) RTC中断	    					 */
		DCD     .															;/* 34) 外部0中断						 */
		DCD     .															;/* 35) 外部1中断						 */

		DCD     .															;/* 36) 外部2中断						 */
		DCD     .															;/* 37) 外部3中断						 */
		DCD     .															;/* 38) ADC中断	    					 */
		DCD     .															;/* 39) 掉电检测(BOD)中断				 */

        DCD     .;usbDevException												;/* 40) USB中断	    					 */
		DCD     can_exception												;/* 41) CAN中断	    					 */
		DCD     .															;/* 42) DMA中断	    					 */
		DCD     .															;/* 43) I2S中断	    					 */

		DCD     .;ethernet_exception											;/* 44) 以太网中断    					 */
		DCD     .															;/* 45) 重复中断定时器RIT中断	    	 */
		DCD     .															;/* 46) 电机PWM中断	    				 */
		DCD     .															;/* 47) 正交编码器ADC中断	    		 */

        DCD     .															;/* 48) PLL1中断	    			     */
		DCD     .															;/* 49) USB活动中断	    				 */
		DCD     .															;/* 50) CAN活动中断	    				 */

;/*********************************************************************************************************************
;** Function name:           void reset_exception(void)
;** Descriptions:            复位异常服务
;** Input parameters:        R0 : 全局数据池源地址
;**                          R1 : 全局数据池目标地址
;**                          R2 :
;**                          R3 : 零初始化目标区地址
;** Output parameters:
;** Returned value:
;**--------------------------------------------------------------------------------------------------------------------
;** Created by:
;** Created Date:            2010-9-3  14:40:21
;** Test recorde:
;**--------------------------------------------------------------------------------------------------------------------
;** Modified by:
;** Modified date:
;** Test recorde:
;*********************************************************************************************************************/
reset_exception
        ;/*
        ; * 1) 初始化全局变量
        ; */
        LDR     r0, =|Load$$RW$$Base|                                		;/* 获取全局数据池源地址				*/
        LDR     r1, =|Image$$RW$$Base|                               		;/* 获取全局数据池目标地址				*/
        LDR     r3, =|Image$$RW$$ZI$$Base|									;/* 获取零初始化目标区地址				*/

        CMP     r0, r1                                                      ;/* Check that they are different		*/
        BEQ     %F1
0		;/* 1.1) 复制原始数据 */
        CMP     r1, r3
        LDRCC   r2, [r0], #4
        STRCC   r2, [r1], #4
        BCC     %B0
1		;/* 1.2) 设置默认数据 */
        LDR     r1, =|Image$$RW$$ZI$$Limit|									;/* 获取零初始化目标区结束地址			*/
        MOV     r2, #0														;/* 默认数据: 0							*/
2
        CMP     r3, r1                                                      ;/* Zero init							*/
        STRCC   r2, [r3], #4
        BCC     %B2

		;/*
		; * 2) 初始化cpu
		; */
		BL		cpu_init

		;/*
		; * 3) 操作系统初始化
		; */
		B 		startup


;/*********************************************************************************************************************
;** Function name:           hard_faults
;** Descriptions:            硬faults
;** Input parameters:
;** Output parameters:
;** Returned value:
;**--------------------------------------------------------------------------------------------------------------------
;** Created by:
;** Created Date:            2010-9-3  14:40:21
;** Test recorde:
;**--------------------------------------------------------------------------------------------------------------------
;** Modified by:
;** Modified date:
;** Test recorde:
;*********************************************************************************************************************/
hard_faults
        ;MOV   	r0,   r0
        ;BX      lr                                                          ;/* 返回                                */
		B		.															;/* 因调试暂时禁能                      */

;/*********************************************************************************************************************
;** Function name:           memory_manage_faults
;** Descriptions:            存储器管理faults,常见诱因如下:
;**                            a) 访问了所有 MPU regions 覆盖范围之外的地址;
;**                            b) 访问了没有存储器与之对应的空地址;
;**                            c) 往只读region写数据;
;**                            d) 用户级下访问了只允许在特权级下访问的地址.
;** Input parameters:
;** Output parameters:
;** Returned value:
;**--------------------------------------------------------------------------------------------------------------------
;** Created by:
;** Created Date:            2010-9-3  14:40:21
;** Test recorde:
;**--------------------------------------------------------------------------------------------------------------------
;** Modified by:
;** Modified date:
;** Test recorde:
;*********************************************************************************************************************/
memory_manage_faults
		B		.

;/*********************************************************************************************************************
;** Function name:           bus_faults
;** Descriptions:            总线faults,常见诱因如下:
;**                            a) 取指, 通常被称作"预取流产"(prefetch abort);
;**                            b) 数据读/写, 通常被称作"数据流产"(data abort);
;** Input parameters:
;** Output parameters:
;** Returned value:
;**--------------------------------------------------------------------------------------------------------------------
;** Created by:
;** Created Date:            2010-9-3  14:40:21
;** Test recorde:
;**--------------------------------------------------------------------------------------------------------------------
;** Modified by:
;** Modified date:
;** Test recorde:
;*********************************************************************************************************************/
bus_faults
		B		.

;/*********************************************************************************************************************
;** Function name:           usage_faults
;** Descriptions:            用法faults,常见诱因如下:
;**                            a) 执行了协处理器指令(不支持);
;**                            b) 执行了未定义指令;
;**                            c) 尝试进入ARM状态;
;**                            d) 无效的中断返回;
;**                            e) 使用多重加载/存储指令时,地址没有对齐.
;** Input parameters:
;** Output parameters:
;** Returned value:
;**--------------------------------------------------------------------------------------------------------------------
;** Created by:
;** Created Date:            2010-9-3  14:40:21
;** Test recorde:
;**--------------------------------------------------------------------------------------------------------------------
;** Modified by:
;** Modified date:
;** Test recorde:
;*********************************************************************************************************************/
usage_faults
		B		.

;/*********************************************************************************************************************
;** Function name:           default_service
;** Descriptions:            默认异常服务
;** Input parameters:
;** Output parameters:
;** Returned value:
;**--------------------------------------------------------------------------------------------------------------------
;** Created by:
;** Created Date:            2010-9-3  14:40:21
;** Test recorde:
;**--------------------------------------------------------------------------------------------------------------------
;** Modified by:
;** Modified date:
;** Test recorde:
;*********************************************************************************************************************/
default_service
		B		.
		ALIGN

;/*********************************************************************************************************************
;** Function name:          系统栈空间
;** Descriptions:
;** Input parameters:
;** Output parameters:
;** Returned value:
;**--------------------------------------------------------------------------------------------------------------------
;** Created by:
;** Created Date:            2010-9-3  14:53:8
;** Test recorde:
;**--------------------------------------------------------------------------------------------------------------------
;** Modified by:
;** Modified date:
;** Test recorde:
;*********************************************************************************************************************/
;/* 全局栈空间 ------------------------------------------------------------*/
		AREA    System, DATA, NOINIT, ALIGN=2
system_stack_base  	SPACE       	SYSTEM_STACK_SIZE

;/*********************************************************************************************************************
;** Function name:          栈空间
;** Descriptions:
;** Input parameters:
;** Output parameters:
;** Returned value:
;**--------------------------------------------------------------------------------------------------------------------
;** Created by:
;** Created Date:            2010-9-3  14:53:8
;** Test recorde:
;**--------------------------------------------------------------------------------------------------------------------
;** Modified by:
;** Modified date:
;** Test recorde:
;*********************************************************************************************************************/
;/* 全局栈空间 ------------------------------------------------------------*/
		AREA    Stack, DATA, NOINIT, ALIGN=2

;/*********************************************************************************************************************
;** Function name:          堆空间
;** Descriptions:
;** Input parameters:
;** Output parameters:
;** Returned value:
;**--------------------------------------------------------------------------------------------------------------------
;** Created by:
;** Created Date:            2010-9-3  14:53:8
;** Test recorde:
;**--------------------------------------------------------------------------------------------------------------------
;** Modified by:
;** Modified date:
;** Test recorde:
;*********************************************************************************************************************/
;/* 全局堆空间 ------------------------------------------------------------*/
        AREA    Heap, DATA, NOINIT


        END																	;/* 汇编文件结束						 */
;/*********************************************************************************************************************
;                                                    END OF FILE
;*********************************************************************************************************************/

